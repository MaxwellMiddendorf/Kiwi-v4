## config/boards/shields/kiwi-v4/Kconfig.defconfig
```kconfig
if SHIELD_KIWI-V4_LEFT

config ZMK_KEYBOARD_NAME
    default "kiwi-v4"

config ZMK_SPLIT_BLE_ROLE_CENTRAL
    default y

endif

if SHIELD_KIWI-V4_LEFT || SHIELD_KIWI-V4_RIGHT

config ZMK_SPLIT
    default y
endif


CONFIG_ZMK_HID_REPORT_TYPE_NKRO=y
```

## config/boards/shields/kiwi-v4/Kconfig.shield
```kconfig
config SHIELD_KIWI-V4_LEFT
	def_bool $(shields_list_contains,kiwi-v4_left)

config SHIELD_KIWI-V3_RIGHT
	def_bool $(shields_list_contains,kiwi-v4_right)
```

## config/west.yml
```yaml
manifest:
  remotes:
    - name: origin 
      url-base: https://github.com/MaxwellMiddendorf/
  projects:
    - name: kiwi-v4
      remote: origin
      revision: master 
      import: config/zmk/app/west.yml
  self:
    path: config
```
